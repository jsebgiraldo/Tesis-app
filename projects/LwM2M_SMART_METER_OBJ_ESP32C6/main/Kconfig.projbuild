## projects/LwM2M_SMART_METER_OBJ_ESP32C6/main/Kconfig.projbuild
```kconfig
menu "WiFi Provisioning Configuration"

    choice PROV_TRANSPORT
        bool "Provisioning Transport Method"
        default PROV_TRANSPORT_BLE
        help
            Wi-Fi provisioning component offers both BLE and SoftAP transports. Choose one.

        config PROV_TRANSPORT_BLE
            bool "BLE"
            select BT_ENABLED
            depends on !IDF_TARGET_ESP32S2

        config PROV_TRANSPORT_SOFTAP
            bool "SoftAP"
    endchoice

    config PROV_SECURITY_VERSION
        int "Security version (0/1/2)"
        default 1
        range 0 2
        help
            Security version to be used for the provisioning.
            0 : No security
            1 : X25519 key exchange + AES-CTR encryption/decryption + Authentication
            2 : SRP6a + AES-GCM encryption/decryption

    config PROV_SEC2_DEV_MODE
        bool "Security 2 dev mode"
        depends on PROV_SECURITY_VERSION = 2
        default y
        help
            This enables the dev mode for Security 2.
            Please note that this mode is NOT recommended for production purpose.

    config PROV_SEC2_USERNAME
        string "Security 2 Username"
        depends on PROV_SECURITY_VERSION = 2
        default "wifiprov"
        help
            Username for Security 2. This value is used for authentication during provisioning.

    config PROV_SEC2_PASSWORD
        string "Security 2 Password"
        depends on PROV_SECURITY_VERSION = 2
        default "abcd1234"
        help
            Password for Security 2. This value is used for authentication during provisioning.

    config PROV_SHOW_QR
        bool "Show QR code in console"
        default n
        help
            Show QR code for provisioning in console output.

    config PROV_RESET_PROVISIONED
        bool "Reset provisioned status of the device"
        default n
        help
            This erases the NVS to reset provisioned status of the device on every reboot.
            Provisioned status is determined by the Wi-Fi STA configuration, saved on the NVS.

    config PROV_REPROVISIONING
        bool "Enable reprovisioning"
        default n
        help
            This option allows for reprovisioning of the device after it has been provisioned.

    config PROV_FORCE_ON_BOOT
        bool "Enable force-provisioning button at boot"
        default y
        help
            When enabled, holding a configured GPIO at boot will force a provisioning reset
            so BLE/SoftAP provisioning becomes visible even if the device was already provisioned.

    config PROV_FORCE_GPIO
        int "GPIO number for force-provisioning button"
        depends on PROV_FORCE_ON_BOOT
        default 9
        range 0 30
        help
            GPIO to read at boot. Typically use the BOOT button (often GPIO9 on ESP32-C6 DevKits).

    config PROV_FORCE_ACTIVE_LOW
        bool "Force button is active-low"
        depends on PROV_FORCE_ON_BOOT
        default y
        help
            If enabled, a logic low level on the configured GPIO indicates button pressed.

    config PROV_RESET_PROV_MGR_ON_FAILURE
        bool "Reset provisioning manager on connection failure"
        default y
        help
            Reset provisioning manager on connection failure.

    config PROV_MGR_CONNECTION_CNT
        int "Maximum connection attempts"
        default 3
        range 1 10
        help
            Maximum number of connection attempts to the AP before resetting the provisioning state machine.

endmenu

menu "Board Features"


config BOARD_BOOT_BUTTON_GPIO
    int "Boot/Factory Reset button GPIO"
    default 9
    range 0 30
    help
        En ESP32-C6 DevKitC-1 el botón BOOT está en GPIO9.

config FACTORY_RESET_HOLD_MS
    int "Factory reset hold time (ms)"
    range 1000 60000
    default 7000

endmenu

menu "LwM2M APP"


config EXAMPLE_MAXIMUM_RETRY
    int "Maximum WiFi reconnect retries"
    default 5
    range 0 100

choice LWM2M_SERVER_SCHEME
    prompt "LwM2M Server Scheme"
    default LWM2M_SERVER_SCHEME_COAP
    help
        Select the transport scheme for LwM2M.

    config LWM2M_SERVER_SCHEME_COAP
        bool "coap (NoSec)"

    config LWM2M_SERVER_SCHEME_COAPS
        bool "coaps (DTLS/PSK)"
endchoice

config LWM2M_SERVER_PORT
    int "LwM2M Server Port"
    default 5685 if LWM2M_SERVER_SCHEME_COAP
    default 5686 if LWM2M_SERVER_SCHEME_COAPS
    range 1 65535
    help
        UDP port of your LwM2M Server. Defaults follow ThingsBoard convention:
          - 5685 for coap (NoSec)
          - 5686 for coaps (DTLS/PSK)

config LWM2M_OVERRIDE_HOSTNAME_ENABLE
    bool "Resolve server host from a hostname"
    default y
    help
        If enabled, the server host will be determined at runtime by resolving
        LWM2M_OVERRIDE_HOSTNAME to an IPv4 address and using that IP in the final URI.
        The scheme and port are taken from the selected options (LwM2M Server Scheme/Port).

config LWM2M_OVERRIDE_HOSTNAME
    string "Hostname to resolve for LwM2M server"
    depends on LWM2M_OVERRIDE_HOSTNAME_ENABLE
    default "thingsboard.edge"
    help
        Hostname that will be resolved on startup and used as the server IP.
        Example: thingsboard.edge.play

config LWM2M_BOOTSTRAP
    bool "Use LwM2M Bootstrap"
    default n

config LWM2M_BOOTSTRAP_URI
    string "Bootstrap Server URI (coap(s)://host:port)"
    depends on LWM2M_BOOTSTRAP
    default "coap://thingsboard.edge:5685"

config LWM2M_SECURITY_PSK_ID
    string "DTLS PSK Identity (if coaps)"
    default ""
    help
        PSK identity for DTLS. Leave empty to use LwM2M Endpoint Name as identity
        (common ThingsBoard convention). Only used if LwM2M Server Scheme is set to coaps.

config LWM2M_SECURITY_PSK_KEY
    string "DTLS PSK Key (hex)"
    default ""
    help
        PSK key in hex, without 0x or spaces. Example: 00112233aabbccddeeff.
        Obtain from ThingsBoard device credentials. Only used if LwM2M Server Scheme
        is set to coaps.

config LWM2M_START_DELAY_MS
    int "Startup delay before first register (ms)"
    default 1000
    range 0 10000
    help
        Wait this long after the LwM2M task starts before creating the client
        and attempting the first Register. Helps avoid transient network/ARP
        races on some Wi‑Fi setups.

config LWM2M_TASK_STACK_SIZE
    int "LwM2M task stack size (bytes)"
    default 8192
    range 4096 32768

config LWM2M_IN_BUFFER_SIZE
    int "Anjay in_buffer_size"
    default 4000
    range 1024 8192

config LWM2M_OUT_BUFFER_SIZE
    int "Anjay out_buffer_size"
    default 4000
    range 1024 8192

config LWM2M_MSG_CACHE_SIZE
    int "Anjay msg_cache_size"
    default 4000
    range 0 8192

endmenu


menu "GeoIP (Approximate Location)"

config GEOLOC_ENABLE
    bool "Enable GeoIP-based initial location"
    default y
    help
        On startup, fetch approximate latitude/longitude from a GeoIP API
        and initialize Location (Object 6) with those values.

config GEOLOC_USE_SERVER_HOST
    bool "Use LwM2M server hostname/IP for geolocation"
    depends on GEOLOC_ENABLE
    default n
    help
        If enabled, query GeoIP for the configured LwM2M server hostname/IP.
        If disabled, query GeoIP without parameter to geolocate the device's
        public IP as seen by the GeoIP service.

config GEOLOC_BASE_URL
    string "GeoIP base URL"
    depends on GEOLOC_ENABLE
    default "http://ip-api.com/json"
    help
        Base URL of the GeoIP service. For example:
          - http://ip-api.com/json
          - http://ip-api.com/json/<host or ip>
        If GEOLOC_USE_SERVER_HOST is enabled, the host/IP will be appended.

endmenu

# Smart Meter Simulation menu removed; observation cadence is controlled by LwM2M pmin/pmax.
```

## projects/LwM2M_SMART_METER_OBJ_ESP32C6/sdkconfig.defaults
```kconfig
# Disable SNTP by default (requested)
# CONFIG_SNTP_ENABLE is not set
#
# WiFi Provisioning Configuration
#
CONFIG_PROV_TRANSPORT_BLE=y
# CONFIG_PROV_TRANSPORT_SOFTAP is not set
CONFIG_PROV_SECURITY_VERSION=1
CONFIG_PROV_SEC2_DEV_MODE=y
CONFIG_PROV_SEC2_USERNAME="wifiprov"
CONFIG_PROV_SEC2_PASSWORD="abcd1234"
CONFIG_PROV_SHOW_QR=y
# CONFIG_PROV_RESET_PROVISIONED is not set
CONFIG_PROV_REPROVISIONING=y
CONFIG_PROV_RESET_PROV_MGR_ON_FAILURE=y
CONFIG_PROV_MGR_CONNECTION_CNT=3

#
# Bluetooth Configuration (Required for BLE provisioning)
#
CONFIG_BT_ENABLED=y
CONFIG_BT_NIMBLE_ENABLED=y
CONFIG_BT_NIMBLE_MAX_CONNECTIONS=1
CONFIG_BT_NIMBLE_MAX_CCCDS=8
CONFIG_BT_NIMBLE_ROLE_PERIPHERAL=y
CONFIG_BT_NIMBLE_ROLE_BROADCASTER=y
# Disable Extended Advertising to use legacy 31-byte payload compatible with protocomm
# (avoids rc=8 when setting adv data)
# CONFIG_BT_NIMBLE_EXT_ADV is not set
CONFIG_BT_LE_DFT_TX_POWER_LEVEL_P9=y

# Make NimBLE GAP device name shorter to fit scan lists
CONFIG_BT_NIMBLE_SVC_GAP_DEVICE_NAME="PROV"
CONFIG_BT_NIMBLE_GAP_DEVICE_NAME_MAX_LEN=12

#
# WiFi Provisioning Component Configuration
#
CONFIG_WIFI_PROV_SCAN_MAX_ENTRIES=16
CONFIG_WIFI_PROV_AUTOSTOP_TIMEOUT=30
CONFIG_WIFI_PROV_BLE_BONDING=y
CONFIG_WIFI_PROV_BLE_SEC_CONN=y
CONFIG_WIFI_PROV_KEEP_BLE_ON_AFTER_PROV=n

#
# Enable Protocol Communication Component
#
CONFIG_ESP_PROTOCOMM_SUPPORT_SECURITY_VERSION_0=y
CONFIG_ESP_PROTOCOMM_SUPPORT_SECURITY_VERSION_1=y
CONFIG_ESP_PROTOCOMM_SUPPORT_SECURITY_VERSION_2=y

## Wi‑Fi SSID/Password removed: use BLE provisioning to set credentials at runtime

# LwM2M server host is handled via CONFIG_LWM2M_OVERRIDE_HOSTNAME (default "192.168.3.100")
# Scheme/port are selected in menuconfig (default coap/5685). Obsolete keys removed.


#
# LwM2M client defaults (buffers, lifetime, server setup)
#
CONFIG_LWM2M_IN_BUFFER_SIZE=4000
CONFIG_LWM2M_OUT_BUFFER_SIZE=4000
CONFIG_LWM2M_MSG_CACHE_SIZE=4000
CONFIG_LWM2M_SERVER_SHORT_ID=123
CONFIG_LWM2M_START_DELAY_MS=1000

# Server address defaults
CONFIG_LWM2M_OVERRIDE_HOSTNAME_ENABLE=y
CONFIG_LWM2M_OVERRIDE_HOSTNAME="192.168.3.100"
CONFIG_LWM2M_SERVER_PORT=5683

# Default to CoAP (UDP). To use CoAPS (DTLS), set this to y in menuconfig or here.
# CONFIG_LWM2M_SERVER_SCHEME_COAPS is not set

# Optional PSK settings (used only if COAPS is enabled)
CONFIG_LWM2M_SECURITY_PSK_ID=""
CONFIG_LWM2M_SECURITY_PSK_KEY=""


#
# TLS/DTLS and mbedTLS defaults for stable builds (ESP-IDF 5.4.1 + Anjay)
# These defaults ensure DTLS/TLS and certificates/PSK features are available
# even if COAPS is disabled at runtime. Safe to keep enabled for COAP.
#
CONFIG_ESP_TLS_USING_MBEDTLS=y

# mbedTLS memory/IO sizes (tuned to fit typical ESP32-C6 RAM)
CONFIG_MBEDTLS_INTERNAL_MEM_ALLOC=y
CONFIG_MBEDTLS_ASYMMETRIC_CONTENT_LEN=y
CONFIG_MBEDTLS_SSL_IN_CONTENT_LEN=16384
CONFIG_MBEDTLS_SSL_OUT_CONTENT_LEN=4096
CONFIG_MBEDTLS_SSL_KEEP_PEER_CERTIFICATE=y

# Protocols
CONFIG_MBEDTLS_SSL_PROTO_TLS1_2=y
CONFIG_MBEDTLS_SSL_PROTO_DTLS=y

# X.509 and PEM (needed for certificate-based security; harmless if using PSK)
CONFIG_MBEDTLS_PEM_PARSE_C=y
CONFIG_MBEDTLS_PEM_WRITE_C=y
CONFIG_MBEDTLS_X509_CRT_PARSE_C=y
CONFIG_MBEDTLS_X509_CRL_PARSE_C=y
CONFIG_MBEDTLS_X509_CSR_PARSE_C=y

# ECC and ECDSA/ECDH (common in LwM2M/DTLS)
CONFIG_MBEDTLS_ECP_C=y
CONFIG_MBEDTLS_ECDH_C=y
CONFIG_MBEDTLS_ECDSA_C=y
CONFIG_MBEDTLS_ECP_NIST_OPTIM=y
CONFIG_MBEDTLS_ECDSA_DETERMINISTIC=y

# Crypto primitives
CONFIG_MBEDTLS_AES_C=y
CONFIG_MBEDTLS_CCM_C=y
CONFIG_MBEDTLS_SHA256_C=y
CONFIG_MBEDTLS_MD_C=y
CONFIG_MBEDTLS_ENTROPY_HARDWARE=y

# PSK modes (for DTLS-PSK if you enable COAPS with PSK on the server)
CONFIG_MBEDTLS_PSK_MODES=y
CONFIG_MBEDTLS_KEY_EXCHANGE_PSK=y
CONFIG_MBEDTLS_KEY_EXCHANGE_ECDHE_PSK=y
CONFIG_MBEDTLS_KEY_EXCHANGE_RSA_PSK=y
CONFIG_MBEDTLS_KEY_EXCHANGE_ECDHE_ECDSA=y
```
