## projects/LwM2M_TEMP_OBJ_ESP32C6/main/Kconfig.projbuild
```kconfig
menu "WiFi Provisioning Configuration"

    choice PROV_TRANSPORT
        bool "Provisioning Transport Method"
        default PROV_TRANSPORT_BLE
        help
            Wi-Fi provisioning component offers both BLE and SoftAP transports. Choose one.

        config PROV_TRANSPORT_BLE
            bool "BLE"
            select BT_ENABLED
            depends on !IDF_TARGET_ESP32S2

        config PROV_TRANSPORT_SOFTAP
            bool "SoftAP"
    endchoice

    config PROV_SECURITY_VERSION
        int "Security version (0/1/2)"
        default 1
        range 0 2
        help
            Security version to be used for the provisioning.
            0 : No security
            1 : X25519 key exchange + AES-CTR encryption/decryption + Authentication
            2 : SRP6a + AES-GCM encryption/decryption

    config PROV_SEC2_DEV_MODE
        bool "Security 2 dev mode"
        depends on PROV_SECURITY_VERSION = 2
        default y
        help
            This enables the dev mode for Security 2.
            Please note that this mode is NOT recommended for production purpose.

    config PROV_SEC2_USERNAME
        string "Security 2 Username"
        depends on PROV_SECURITY_VERSION = 2
        default "wifiprov"
        help
            Username for Security 2. This value is used for authentication during provisioning.

    config PROV_SEC2_PASSWORD
        string "Security 2 Password"
        depends on PROV_SECURITY_VERSION = 2
        default "abcd1234"
        help
            Password for Security 2. This value is used for authentication during provisioning.

    config PROV_SHOW_QR
        bool "Show QR code in console"
        default n
        help
            Show QR code for provisioning in console output.

    config PROV_RESET_PROVISIONED
        bool "Reset provisioned status of the device"
        default n
        help
            This erases the NVS to reset provisioned status of the device on every reboot.
            Provisioned status is determined by the Wi-Fi STA configuration, saved on the NVS.

    config PROV_REPROVISIONING
        bool "Enable reprovisioning"
        default n
        help
            This option allows for reprovisioning of the device after it has been provisioned.

    config PROV_FORCE_ON_BOOT
        bool "Enable force-provisioning button at boot"
        default y
        help
            When enabled, holding a configured GPIO at boot will force a provisioning reset
            so BLE/SoftAP provisioning becomes visible even if the device was already provisioned.

    config PROV_FORCE_GPIO
        int "GPIO number for force-provisioning button"
        depends on PROV_FORCE_ON_BOOT
        default 9
        range 0 30
        help
            GPIO to read at boot. Typically use the BOOT button (often GPIO9 on ESP32-C6 DevKits).

    config PROV_FORCE_ACTIVE_LOW
        bool "Force button is active-low"
        depends on PROV_FORCE_ON_BOOT
        default y
        help
            If enabled, a logic low level on the configured GPIO indicates button pressed.

    config PROV_RESET_PROV_MGR_ON_FAILURE
        bool "Reset provisioning manager on connection failure"
        default y
        help
            Reset provisioning manager on connection failure.

    config PROV_MGR_CONNECTION_CNT
        int "Maximum connection attempts"
        default 3
        range 1 10
        help
            Maximum number of connection attempts to the AP before resetting the provisioning state machine.

endmenu

menu "Board Features"

config BOARD_HAS_WS2812
    bool "Board has a single WS2812 RGB LED"
    default y

config BOARD_WS2812_GPIO
    int "WS2812 data GPIO"
    depends on BOARD_HAS_WS2812
    default 8
    range 0 30
    help
        ESP32-C6-DevKitC-1 usa GPIO8 para el LED RGB integrado.

config BOARD_BOOT_BUTTON_GPIO
    int "Boot/Factory Reset button GPIO"
    default 9
    range 0 30
    help
        En ESP32-C6 DevKitC-1 el botón BOOT está en GPIO9.

config FACTORY_RESET_HOLD_MS
    int "Factory reset hold time (ms)"
    range 1000 60000
    default 7000

endmenu

menu "LwM2M APP"

config EXAMPLE_WIFI_SSID
    string "WiFi SSID"
    default ""

config EXAMPLE_WIFI_PASSWORD
    string "WiFi Password"
    default ""

config EXAMPLE_MAXIMUM_RETRY
    int "Maximum WiFi reconnect retries"
    default 5
    range 0 100

choice LWM2M_SERVER_SCHEME
    prompt "LwM2M Server Scheme"
    default LWM2M_SERVER_SCHEME_COAP
    help
        Select the transport scheme for LwM2M.

    config LWM2M_SERVER_SCHEME_COAP
        bool "coap (NoSec)"

    config LWM2M_SERVER_SCHEME_COAPS
        bool "coaps (DTLS/PSK)"
endchoice

config LWM2M_SERVER_PORT
    int "LwM2M Server Port"
    default 5685 if LWM2M_SERVER_SCHEME_COAP
    default 5686 if LWM2M_SERVER_SCHEME_COAPS
    range 1 65535
    help
        UDP port of your LwM2M Server. Defaults follow ThingsBoard convention:
          - 5685 for coap (NoSec)
          - 5686 for coaps (DTLS/PSK)

config LWM2M_OVERRIDE_HOSTNAME_ENABLE
    bool "Resolve server host from a hostname"
    default y
    help
        If enabled, the server host will be determined at runtime by resolving
        LWM2M_OVERRIDE_HOSTNAME to an IPv4 address and using that IP in the final URI.
        The scheme and port are taken from the selected options (LwM2M Server Scheme/Port).

config LWM2M_OVERRIDE_HOSTNAME
    string "Hostname to resolve for LwM2M server"
    depends on LWM2M_OVERRIDE_HOSTNAME_ENABLE
    default "192.168.3.100"
    help
        Hostname that will be resolved on startup and used as the server IP.
        Example: thingsboard.edge.play

menu "LwM2M Bootstrap Configuration"

    config LWM2M_BOOTSTRAP
        bool "Enable LwM2M Bootstrap (ThingsBoard Auto-Provisioning)"
        default n
        help
            Enable LwM2M Bootstrap mode for automatic device provisioning.
            When enabled, device connects to Bootstrap Server first to receive
            credentials and server configuration. ThingsBoard will automatically
            create the device and provision credentials.

    choice LWM2M_BOOTSTRAP_MODE
        prompt "Bootstrap Mode"
        depends on LWM2M_BOOTSTRAP
        default LWM2M_BOOTSTRAP_MODE_CLIENT_INITIATED
        help
            Select how the bootstrap process is initiated

        config LWM2M_BOOTSTRAP_MODE_CLIENT_INITIATED
            bool "Client-Initiated Bootstrap"
            help
                Device initiates bootstrap by sending Bootstrap-Request to server

        config LWM2M_BOOTSTRAP_MODE_SERVER_INITIATED
            bool "Server-Initiated Bootstrap"
            help
                Server initiates bootstrap (requires device to be pre-configured)

    endchoice

    config LWM2M_BOOTSTRAP_URI
        string "Bootstrap Server URI"
        depends on LWM2M_BOOTSTRAP
        default "coap://10.42.0.1:5687"
        help
            URI of ThingsBoard Bootstrap Server.
            Format: coap://host:port or coaps://host:port
            Examples:
              - coap://10.42.0.1:5687 (ThingsBoard Bootstrap Server - from your config)
              - coap://192.168.1.100:5687 (ThingsBoard Edge local)
            
            From your ThingsBoard profile:
              - Bootstrap Server Port: 5687 (shortServerId: 111)
              - LwM2M Server Port: 5685 (shortServerId: 123)

    config LWM2M_BOOTSTRAP_SECURITY_MODE
        int "Bootstrap Security Mode"
        depends on LWM2M_BOOTSTRAP
        default 3
        range 0 4
        help
            LwM2M Security Mode for Bootstrap connection:
            0 = PSK (Pre-Shared Key)
            3 = NoSec (No Security)
            
            ThingsBoard typically uses NoSec (3) for Bootstrap,
            then provisions DTLS credentials for LwM2M Server connection.

    config LWM2M_BOOTSTRAP_PSK_ID
        string "Bootstrap PSK Identity"
        depends on LWM2M_BOOTSTRAP
        depends on LWM2M_BOOTSTRAP_SECURITY_MODE = 0
        default ""
        help
            PSK Identity for Bootstrap Server (only if using PSK mode).
            Leave empty to use endpoint name as identity.

    config LWM2M_BOOTSTRAP_PSK_KEY
        string "Bootstrap PSK Key (hex)"
        depends on LWM2M_BOOTSTRAP
        depends on LWM2M_BOOTSTRAP_SECURITY_MODE = 0
        default ""
        help
            PSK Key in hexadecimal for Bootstrap Server.
            Example: 0123456789ABCDEF

    config LWM2M_BOOTSTRAP_SERVER_ACCOUNT_TIMEOUT
        int "Bootstrap Server Account Timeout (seconds)"
        depends on LWM2M_BOOTSTRAP
        default 0
        range 0 86400
        help
            Bootstrap Server Account lifetime (0 = no timeout).
            After this time, device will re-bootstrap.

endmenu

config LWM2M_SECURITY_PSK_ID
    string "DTLS PSK Identity (if coaps)"
    default ""
    help
        PSK identity for DTLS. Leave empty to use LwM2M Endpoint Name as identity
        (common ThingsBoard convention). Only used if LwM2M Server Scheme is set to coaps.

config LWM2M_SECURITY_PSK_KEY
    string "DTLS PSK Key (hex)"
    default ""
    help
        PSK key in hex, without 0x or spaces. Example: 00112233aabbccddeeff.
        Obtain from ThingsBoard device credentials. Only used if LwM2M Server Scheme
        is set to coaps.

config LWM2M_START_DELAY_MS
    int "Startup delay before first register (ms)"
    default 1000
    range 0 10000
    help
        Wait this long after the LwM2M task starts before creating the client
        and attempting the first Register. Helps avoid transient network/ARP
        races on some Wi‑Fi setups.

config LWM2M_TASK_STACK_SIZE
    int "LwM2M task stack size (bytes)"
    default 8192
    range 4096 32768

config LWM2M_IN_BUFFER_SIZE
    int "Anjay in_buffer_size"
    default 4000
    range 1024 8192

config LWM2M_OUT_BUFFER_SIZE
    int "Anjay out_buffer_size"
    default 4000
    range 1024 8192

config LWM2M_MSG_CACHE_SIZE
    int "Anjay msg_cache_size"
    default 4000
    range 0 8192

endmenu

menu "GeoIP (Approximate Location)"

config GEOLOC_ENABLE
    bool "Enable GeoIP-based location"
    default y
    help
        If enabled, the Location (Object 6) will be periodically updated by
        querying a public IP geolocation service and mapping the result to
        Latitude/Longitude and Timestamp resources.

config GEOLOC_USE_SERVER_HOST
    bool "Use default service base URL"
    default y
    help
        If enabled, use the base URL configured below. If disabled, the code can
        be modified to use a custom resolver.

config GEOLOC_BASE_URL
    string "GeoIP service base URL"
    depends on GEOLOC_USE_SERVER_HOST
    default "http://ip-api.com/json"
    help
        Base URL to query public IP geolocation. Example providers:
          - http://ip-api.com/json
          - https://ipinfo.io/json
        Note: These services have rate limits; use responsibly.

config GEOLOC_REFRESH_MINUTES
    int "GeoIP refresh period (minutes)"
    depends on GEOLOC_ENABLE
    range 1 720
    default 60
    help
        Interval between GeoIP queries. Choose a higher value to respect
        public service rate limits.

config GEOLOC_HTTP_TIMEOUT_MS
    int "GeoIP HTTP timeout (ms)"
    depends on GEOLOC_ENABLE
    range 500 10000
    default 2500
    help
        Timeout for the HTTP client when querying the geolocation service.

config GEOLOC_PERSIST_NVS
    bool "Persist last location in NVS"
    depends on GEOLOC_ENABLE
    default y
    help
        Store last successful latitude/longitude in NVS and restore on boot
        before first network-based update.

config GEOLOC_FALLBACK_LAT
    string "Fallback latitude (string)"
    depends on GEOLOC_ENABLE
    default "5.000000"
    help
        Latitude used as initial value if no persisted location exists.

config GEOLOC_FALLBACK_LON
    string "Fallback longitude (string)"
    depends on GEOLOC_ENABLE
    default "-74.000000"
    help
        Longitude used as initial value if no persisted location exists.

endmenu

menu "LwM2M Network Selection"
    config LWM2M_NETWORK_USE_WIFI
        bool "Use WiFi connectivity" 
        default y
    config LWM2M_NETWORK_USE_THREAD
        bool "Use Thread (OpenThread) connectivity"
        depends on OPENTHREAD_ENABLED
        default n
    comment "Enable exactly one or both (runtime selection TBD). Currently if THREAD is enabled WiFi init still happens unless manually disabled."
endmenu

menu "Thread Joiner Commissioning"
    depends on LWM2M_NETWORK_USE_THREAD
    config LWM2M_THREAD_JOINER
        bool "Enable Thread Joiner commissioning"
        default y
        help
            Start the OpenThread Joiner process using the PSKd to attach to an external Border Router.
    config LWM2M_THREAD_JOINER_PSKD
        string "Thread Joiner PSKd"
        depends on LWM2M_THREAD_JOINER
        default "J01NME"
        help
            The Pre-Shared Key for Device (PSKd) used during Joiner commissioning. Must match what the Border Router expects.
endmenu

menu "LwM2M Dynamic Discovery"
    config LWM2M_DNS_DISCOVERY_ENABLE
        bool "Enable DNS discovery of LwM2M server"
        default y
        help
            If enabled, device intentará resolver el hostname configurado para obtener la IP del servidor LwM2M (p.ej. en red Thread via SRP/DNS-SD).
    config LWM2M_DNS_DISCOVERY_HOST
        string "Discovery hostname"
        depends on LWM2M_DNS_DISCOVERY_ENABLE
        default "leshan.default.service.arpa"
        help
            Hostname a resolver dinámicamente. Debe existir un registro AAAA (o resolverse internamente) dentro de la red.
    config LWM2M_DNS_DISCOVERY_PORT
        int "Discovery port"
        depends on LWM2M_DNS_DISCOVERY_ENABLE
        range 1 65535
        default 5
        help
            Puerto CoAP (5685) o CoAPS (5684) del servidor descubierto.
    config LWM2M_DNS_DISCOVERY_SECURE
        bool "Use DTLS (coaps://) for discovered server"
        depends on LWM2M_DNS_DISCOVERY_ENABLE
        default n
        help
            Si se habilita, construye URI coaps:// en lugar de coap:// (requiere credenciales DTLS configuradas en Security Object).
endmenu
```

## projects/LwM2M_TEMP_OBJ_ESP32C6/sdkconfig.defaults
```kconfig
#
# WiFi Provisioning Configuration
#
CONFIG_PROV_TRANSPORT_BLE=y
# CONFIG_PROV_TRANSPORT_SOFTAP is not set
CONFIG_PROV_SECURITY_VERSION=1
CONFIG_PROV_SEC2_DEV_MODE=y
CONFIG_PROV_SEC2_USERNAME="wifiprov"
CONFIG_PROV_SEC2_PASSWORD="abcd1234"
CONFIG_PROV_SHOW_QR=y
# CONFIG_PROV_RESET_PROVISIONED is not set
CONFIG_PROV_REPROVISIONING=y
CONFIG_PROV_RESET_PROV_MGR_ON_FAILURE=y
CONFIG_PROV_MGR_CONNECTION_CNT=3

#
# Bluetooth Configuration (Required for BLE provisioning)
#
CONFIG_BT_ENABLED=y
CONFIG_BT_NIMBLE_ENABLED=y
CONFIG_BT_NIMBLE_MAX_CONNECTIONS=1
CONFIG_BT_NIMBLE_MAX_CCCDS=8
CONFIG_BT_NIMBLE_ROLE_PERIPHERAL=y
CONFIG_BT_NIMBLE_ROLE_BROADCASTER=y
# Disable Extended Advertising to use legacy 31-byte payload compatible with protocomm
# (avoids rc=8 when setting adv data)
# CONFIG_BT_NIMBLE_EXT_ADV is not set
CONFIG_BT_LE_DFT_TX_POWER_LEVEL_P9=y

# Make NimBLE GAP device name shorter to fit scan lists
CONFIG_BT_NIMBLE_SVC_GAP_DEVICE_NAME="PROV"
CONFIG_BT_NIMBLE_GAP_DEVICE_NAME_MAX_LEN=12

#
# WiFi Provisioning Component Configuration
#
CONFIG_WIFI_PROV_SCAN_MAX_ENTRIES=16
CONFIG_WIFI_PROV_AUTOSTOP_TIMEOUT=30
CONFIG_WIFI_PROV_BLE_BONDING=y
CONFIG_WIFI_PROV_BLE_SEC_CONN=y
CONFIG_WIFI_PROV_KEEP_BLE_ON_AFTER_PROV=n

#
# Enable Protocol Communication Component
#
CONFIG_ESP_PROTOCOMM_SUPPORT_SECURITY_VERSION_0=y
CONFIG_ESP_PROTOCOMM_SUPPORT_SECURITY_VERSION_1=y
CONFIG_ESP_PROTOCOMM_SUPPORT_SECURITY_VERSION_2=y

#
# Project Wi‑Fi defaults
#
CONFIG_EXAMPLE_WIFI_SSID="PI5_AP"
CONFIG_EXAMPLE_WIFI_PASSWORD="banano2025"

# LwM2M server host is handled via CONFIG_LWM2M_OVERRIDE_HOSTNAME (default "192.168.3.100")
# Scheme/port are selected in menuconfig (default coap/5685). Obsolete keys removed.
```
