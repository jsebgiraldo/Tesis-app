## projects/LwM2M_esp32/main/Kconfig.projbuild
```kconfig
menu "LwM2M APP"

config EXAMPLE_WIFI_SSID
    string "WiFi SSID"
    default "SEBAS_LAN_AP"

config EXAMPLE_WIFI_PASSWORD
    string "WiFi Password"
    default "1053866507"

config EXAMPLE_MAXIMUM_RETRY
    int "Maximum WiFi reconnect retries"
    default 5
    range 0 100

config LWM2M_ENDPOINT_NAME
    string "LwM2M Endpoint Name"
    default "esp32c6-temp"

config LWM2M_SERVER_URI
    string "LwM2M Server URI (coap(s)://host:port)"
    default "coap://192.168.137.1:5683"

config LWM2M_BOOTSTRAP
    bool "Use LwM2M Bootstrap"
    default n

config LWM2M_BOOTSTRAP_URI
    string "Bootstrap Server URI (coap(s)://host:port)"
    depends on LWM2M_BOOTSTRAP
    default "coap://leshan.eclipseprojects.io:5783"

config LWM2M_SECURITY_PSK_ID
    string "DTLS PSK Identity (if coaps)"
    default ""

config LWM2M_SECURITY_PSK_KEY
    string "DTLS PSK Key (hex)"
    default ""

config LWM2M_CONNECT_TIMEOUT_S
    int "Registration attempt timeout (seconds)"
    default 30
    range 5 300
    help
        Maximum time to wait for a Register/Update attempt to complete before
        treating it as failed and applying the retry policy.

config LWM2M_START_DELAY_MS
    int "Startup delay before first register (ms)"
    default 1000
    range 0 10000
    help
        Wait this long after the LwM2M task starts before creating the client
        and attempting the first Register. Helps avoid transient network/ARP
        races on some Wi‑Fi setups.

config LWM2M_RETRY_DELAY_S
    int "Retry delay after failed registration (seconds)"
    default 5
    range 1 300

config LWM2M_MAX_RETRIES
    int "Max registration retries (0=infinite)"
    default 0
    range 0 100

config LWM2M_RETRY_MAX_DELAY_S
    int "Retry delay cap for exponential backoff (seconds)"
    default 60
    range 1 600

config LWM2M_RETRY_JITTER_PCT
    int "Retry jitter percentage (+/-)"
    default 20
    range 0 100

config LWM2M_TASK_STACK_SIZE
    int "LwM2M task stack size (bytes)"
    default 8192
    range 4096 32768

config LWM2M_IN_BUFFER_SIZE
    int "Anjay in_buffer_size"
    default 4000
    range 1024 8192

config LWM2M_OUT_BUFFER_SIZE
    int "Anjay out_buffer_size"
    default 4000
    range 1024 8192

config LWM2M_MSG_CACHE_SIZE
    int "Anjay msg_cache_size"
    default 4000
    range 0 8192

config LWM2M_SEND_ENABLE
    bool "Enable LwM2M Send (TS 1.1)"
    default y


endmenu
```

## projects/OpenThread/sdkconfig.defaults
```kconfig
# OpenThread Configuration
CONFIG_OPENTHREAD_ENABLED=y
CONFIG_OPENTHREAD_CLI=y
CONFIG_OPENTHREAD_LOG_LEVEL_DYNAMIC=y
CONFIG_OPENTHREAD_LOG_LEVEL_INFO=y

# Watchdog Configuration
# Deshabilitar Task Watchdog porque OpenThread mainloop bloquea CPU
CONFIG_ESP_TASK_WDT_EN=n

# Thread Network Configuration - Valores se configuran en código
# CONFIG_OPENTHREAD_NETWORK_NAME se maneja en código
# CONFIG_OPENTHREAD_NETWORK_CHANNEL se maneja en código
# CONFIG_OPENTHREAD_NETWORK_PANID se maneja en código
# CONFIG_OPENTHREAD_NETWORK_EXTPANID debe ser hex sin comillas
# CONFIG_OPENTHREAD_NETWORK_MASTERKEY debe ser hex sin comillas

# ESP32C6 Radio Configuration
CONFIG_IEEE802154_ENABLED=y
CONFIG_IEEE802154_RX_BUFFER_SIZE=20
CONFIG_IEEE802154_SLEEP_ENABLE=y

# FreeRTOS Configuration
CONFIG_FREERTOS_HZ=1000
CONFIG_FREERTOS_UNICORE=n

# Logging
CONFIG_LOG_DEFAULT_LEVEL_INFO=y
CONFIG_LOG_MAXIMUM_LEVEL_VERBOSE=y

# lwIP Configuration
CONFIG_LWIP_TCPIP_TASK_STACK_SIZE=4096
CONFIG_LWIP_IPV6_NUM_ADDRESSES=8
CONFIG_LWIP_MULTICAST_PING=y
CONFIG_LWIP_HOOK_IP6_SELECT_SRC_ADDR_CUSTOM=y

# Thread Features
CONFIG_OPENTHREAD_BORDER_ROUTER=n
CONFIG_OPENTHREAD_COMMISSIONER=n
CONFIG_OPENTHREAD_JOINER=n
CONFIG_OPENTHREAD_DIAG=y
# Disable DUA to suppress warning (not needed for basic Thread functionality)
CONFIG_OPENTHREAD_DUA=n

# ESP System Settings
CONFIG_ESP_MAIN_TASK_STACK_SIZE=8192
CONFIG_ESP_SYSTEM_EVENT_TASK_STACK_SIZE=4096
# Usar USB Serial/JTAG para console (XIAO ESP32-C6)
CONFIG_ESP_CONSOLE_USB_SERIAL_JTAG=y

# Partition Table - Custom with OTA support
CONFIG_PARTITION_TABLE_CUSTOM=y
CONFIG_PARTITION_TABLE_CUSTOM_FILENAME="partitions.csv"
CONFIG_PARTITION_TABLE_FILENAME="partitions.csv"

# Flash Configuration - ESP32-C6 XIAO has 4MB flash
CONFIG_ESPTOOLPY_FLASHSIZE_4MB=y
CONFIG_ESPTOOLPY_FLASHSIZE="4MB"

# Optimization
CONFIG_COMPILER_OPTIMIZATION_SIZE=y

# Compiler Warnings - Disable implicit-function-declaration error for Anjay compatibility
CONFIG_COMPILER_WARN_WRITE_STRINGS=n

# mbedTLS Configuration (required for LwM2M/Anjay)
# Basic TLS/DTLS
CONFIG_MBEDTLS_TLS_ENABLED=y
CONFIG_MBEDTLS_CERTIFICATE_BUNDLE=y
CONFIG_MBEDTLS_CERTIFICATE_BUNDLE_DEFAULT_FULL=y
CONFIG_MBEDTLS_SSL_PROTO_TLS1_2=y
CONFIG_MBEDTLS_SSL_PROTO_DTLS=y
CONFIG_MBEDTLS_SSL_MAX_CONTENT_LEN=16384
CONFIG_MBEDTLS_SSL_IN_CONTENT_LEN=16384
CONFIG_MBEDTLS_SSL_OUT_CONTENT_LEN=16384

# PSK (Pre-Shared Key) Support - CRITICAL for Anjay
CONFIG_MBEDTLS_PSK_MODES=y
CONFIG_MBEDTLS_KEY_EXCHANGE_PSK=y
CONFIG_MBEDTLS_KEY_EXCHANGE_DHE_PSK=y
CONFIG_MBEDTLS_KEY_EXCHANGE_ECDHE_PSK=y
CONFIG_MBEDTLS_KEY_EXCHANGE_RSA_PSK=y

# Disable conflicting options
CONFIG_MBEDTLS_SSL_PROTO_TLS1=n
CONFIG_MBEDTLS_SSL_PROTO_TLS1_1=n

# Elliptic Curve Support
CONFIG_MBEDTLS_ECDH_C=y
CONFIG_MBEDTLS_ECDSA_C=y
CONFIG_MBEDTLS_ECP_C=y
CONFIG_MBEDTLS_KEY_EXCHANGE_ECDHE_ECDSA=y
CONFIG_MBEDTLS_KEY_EXCHANGE_ECDHE_RSA=y
CONFIG_MBEDTLS_KEY_EXCHANGE_ECDH_ECDSA=y
CONFIG_MBEDTLS_KEY_EXCHANGE_ECDH_RSA=y

# Additional ciphers
CONFIG_MBEDTLS_CCM_C=y
CONFIG_MBEDTLS_GCM_C=y
CONFIG_MBEDTLS_AES_C=y
CONFIG_MBEDTLS_SHA256_C=y

# Enable client/server modes
CONFIG_MBEDTLS_TLS_CLIENT=y
CONFIG_MBEDTLS_TLS_SERVER=n

# Anjay/LwM2M Configuration
CONFIG_ANJAY_WITH_LOGS=y
CONFIG_ANJAY_WITH_TRACE_LOGS=n
CONFIG_ANJAY_WITH_MODULE_ACCESS_CONTROL=y
CONFIG_ANJAY_WITH_MODULE_SECURITY=y
CONFIG_ANJAY_WITH_MODULE_SERVER=y
```

## projects/hello_esp32/main/Kconfig.projbuild
```kconfig
menu "Hello ESP32 app configuration"

config HELLO_BLINK_GPIO
    int "GPIO para LED (blink)"
    range 0 39
    default 2
    help
        Selecciona el GPIO del LED para el ejemplo de parpadeo.

endmenu
```

## projects/hello_esp32/sdkconfig.defaults
```kconfig
# Serial console
CONFIG_ESP_CONSOLE_UART_DEFAULT=y
CONFIG_ESP_CONSOLE_UART_BAUDRATE=115200

# Logging
CONFIG_LOG_DEFAULT_LEVEL_INFO=y

# Reduce bootloader verbosity a bit
CONFIG_BOOTLOADER_LOG_LEVEL_INFO=y

# Example defaults
CONFIG_HELLO_BLINK_GPIO=2
```

## projects/mqtt_node/Kconfig.projbuild
```kconfig
menu "MQTT Node Options"

config MQTT_USE_WIFI
    bool "Usar WiFi"
    default n

config MQTT_USE_ETH
    bool "Usar Ethernet"
    default y

config MQTT_USE_THREAD
    bool "Usar Thread (ESP32-H2/H4)"
    default n

config MQTT_WIFI_SSID
    string "WiFi SSID"
    default "YOUR_SSID"

config MQTT_WIFI_PASS
    string "WiFi Password"
    default "YOUR_PASS"

config MQTT_BROKER_URI
    string "MQTT Broker URI"
    default "mqtt://test.mosquitto.org:1883"

endmenu
```

## projects/mqtt_node/main/Kconfig.projbuild
```kconfig
menu "MQTT Node Options"

config MQTT_USE_WIFI
    bool "Usar WiFi"
    default n

config MQTT_USE_ETH
    bool "Usar Ethernet"
    default y

config MQTT_USE_THREAD
    bool "Usar Thread (ESP32-H2/H4)"
    default n

config APP_USE_ETHERNET
    bool "Usar Ethernet (modo QEMU/bridge)"
    default n

config MQTT_WIFI_SSID
    string "WiFi SSID"
    default "YOUR_SSID"

config MQTT_WIFI_PASS
    string "WiFi Password"
    default "YOUR_PASS"

config MQTT_BROKER_URI
    string "MQTT Broker URI"
    default "mqtt://test.mosquitto.org:1883"

config TB_HOST
    string "ThingsBoard Host"
    default "host.docker.internal"

config TB_PORT
    int "ThingsBoard MQTT Port"
    default 1883

config TB_TOKEN
    string "ThingsBoard Device Token"
    default "YOUR_TB_DEVICE_TOKEN"

endmenu
```

## projects/mqtt_node/sdkconfig.defaults
```kconfig
# Network selection
CONFIG_MQTT_USE_WIFI=y
# CONFIG_MQTT_USE_ETH is not set
# CONFIG_MQTT_USE_THREAD is not set

# WiFi creds (cambiar por menuconfig o sobrescribir)
CONFIG_MQTT_WIFI_SSID="YOUR_SSID"
CONFIG_MQTT_WIFI_PASS="YOUR_PASS"

# MQTT broker
CONFIG_MQTT_BROKER_URI="mqtt://test.mosquitto.org:1883"

# Enable required components
CONFIG_MQTT_PROTOCOL_311=y
CONFIG_MQTT_TRANSPORT_SSL=n
```

## projects/tcp_server/sdkconfig.defaults
```kconfig
# Enable Wi-Fi Station and BLE provisioning using NimBLE
CONFIG_ESP_WIFI_ENABLED=y
CONFIG_ESP_WIFI_STA_ENABLE=y

# Enable BT Controller and BLE stack (NimBLE is smaller)
CONFIG_BT_ENABLED=y
CONFIG_BT_NIMBLE_ENABLED=y
CONFIG_BT_NIMBLE_HOST=y
CONFIG_BT_NIMBLE_ROLE_PERIPHERAL=y
CONFIG_BT_NIMBLE_ROLE_BROADCASTER=y
CONFIG_BT_CONTROLLER_ENABLED=y
CONFIG_BT_BLE_ENABLED=y

# Provisioning manager and BLE scheme
CONFIG_WIFI_PROV_MANAGER_SCHEME_BLE=y
CONFIG_WIFI_PROV_BLE_FORCE_ENCRYPTION=y
CONFIG_WIFI_PROV_SEC_1=y

# Increase GATT MTU a bit for provisioning
CONFIG_BT_NIMBLE_GATT_MAX_MTU=256

# Default Proof of Possession (can be overridden in menuconfig)
CONFIG_EXAMPLE_PROV_POP="abcd1234"
```
